/*
 * functions.c
 *
 * Различные вспомогательные функции.
 * The various support functions.
 */

// Перенос значения в новый диапазон
long map(long x, long in_min, long in_max, long out_min, long out_max) {
	if(x<in_min) x = in_min; // Ограничение значения по нижней границе
	if(x>in_max) x = in_max; // Ограничение значения по верхней границе
	x = (x - in_min) * (out_max - out_min) / (in_max - in_min) + out_min;
	return x;
}

// Меняет значения двух переменных местами
void swap(uint8_t *x, uint8_t *y) {
	if(x != y) {
		*x ^= *y;
		*y ^= *x;
		*x ^= *y;
	}
}

/***
     millis() возвращает количество
     миллисекунд с момента включения
     процессора
***/

uint64_t _millis = 0; // Счетчик миллисекунд
uint16_t _1000us = 0; // Счетчик микросекунд

// Таймер вызывается каждые 0.256 микросекунд
ISR(TIMER0_OVF_vect) {
	_1000us += 256; // Увеличиваем счетчик микросекунд
	while(_1000us > 1000) { // Если уже прошла миллисекунда
		_millis++; // Увеличиваем счетчик миллисекунд
		_1000us -= 1000; // Уменьшаем счетчик микросекунд
	}
	if(_millis>=65535) _millis = 0; // Защита от переполнения
}

// Инициализация счетчика
void init_millis() {
	TCCR0B |= (1<<CS01);
	TIMSK0 |= (1<<TOIE0);
}

// Безопасный доступ к счетчику
uint64_t get_millis() {
	cli(); // Отключаем прерывания
	uint64_t m = _millis; // Получаем значение счетчика
	sei(); // Включаем прерывания
	return m; // Возвращаем значение счетчика
}

// Перезагрузка МК
void(* ATmegaReset) (void) = 0;
